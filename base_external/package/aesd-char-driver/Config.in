## base_external/package/aesd-char-driver/Config.in
```kconfig
config BR2_PACKAGE_AESD_CHAR_DRIVER
	bool "aesd-char-driver"
	help
	  The char driver module is loaded
```

## base_external/package/ldd/Config.in
```kconfig
config BR2_PACKAGE_LDD
	bool "ldd"
	help
	  To build and install the misc-modules and skull components to the root fs.
	  Used to understand buildroot external trees and package builds.
```
